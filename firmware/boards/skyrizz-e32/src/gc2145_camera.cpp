#include "nema/skyrizze32/gc2145_camera.h"
#include "nema/skyrizze32/board_config.h"
#include "nema/skyrizze32/xl9535.h"
#include "nema/runtime.h"
#include "nema/log/logger.h"
#include <esp_cam_ctlr.h>
#include <esp_cam_ctlr_dvp.h>
#include <esp_heap_caps.h>
#include <freertos/FreeRTOS.h>
#include <freertos/task.h>
#include <Wire.h>
#include <string>

namespace nema::skyrizze32 {

// ── GC2145 SCCB init tables ────────────────────────────────────────────────
// Ported verbatim from Rust reference camera.rs GC2145_DEFAULT_INIT and
// GC2145_RGB565_OVERRIDE. Sentinel: {0xFD, delay_ms}, {0xEE, 0xEE} = end.
static constexpr uint8_t kRegDly = 0xFD;
static constexpr uint8_t kRegEnd = 0xEE;

static const uint8_t kGc2145DefaultInit[][2] = {
    // system / soft reset
    {0xFE, 0xF0}, {0xFE, 0xF0}, {0xFE, 0xF0},
    {0xFC, 0x06}, {0xF6, 0x00}, {0xF7, 0x1D}, {0xF8, 0x83},
    {0xFA, 0x00}, {0xF9, 0xFE}, {0xC2, 0x00}, {0xF2, 0x0F},
    // analog & cisctl (page 0)
    {0xFE, 0x00},
    {0x03, 0x04}, {0x04, 0x62}, {0x05, 0x01}, {0x06, 0x3B},
    {0x09, 0x00}, {0x0A, 0x00}, {0x0B, 0x00}, {0x0C, 0x00},
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    {0x2D, 0x60}, {0x30, 0x01}, {0x31, 0x90}, {0x33, 0x06}, {0x34, 0x01},
    // ISP
    {0x80, 0xFF}, {0x81, 0x24}, {0x82, 0xFA}, {0x83, 0x00},
    {0x84, 0x02}, {0x86, 0x03}, {0x88, 0x03}, {0x89, 0x03},
    {0x85, 0x30}, {0x8A, 0x00}, {0x8B, 0x00}, {0xB0, 0x55},
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    {0x95, 0x04}, {0x96, 0xB0}, {0x97, 0x06}, {0x98, 0x40},
    // BLK
    {0x18, 0x02}, {0x40, 0x42}, {0x41, 0x00}, {0x43, 0x54},
    {0x5E, 0x00}, {0x5F, 0x00}, {0x60, 0x00}, {0x61, 0x00},
    {0x62, 0x00}, {0x63, 0x00}, {0x64, 0x00}, {0x65, 0x00},
    {0x66, 0x20}, {0x67, 0x20}, {0x68, 0x20}, {0x69, 0x20},
    {0x76, 0x00}, {0x6A, 0x00}, {0x6B, 0x00}, {0x6C, 0x3E},
    {0x6D, 0x3E}, {0x6F, 0x3F}, {0x70, 0x00}, {0x71, 0x00},
    {0x72, 0xF0}, {0x7E, 0x3C}, {0x7F, 0x00},
    // ISP page 2: ASDE
    {0xFE, 0x02}, {0x48, 0x15}, {0x49, 0x00}, {0x4B, 0x0B}, {0xFE, 0x00},
    // AEC (page 1)
    {0xFE, 0x01},
    {0x01, 0x04}, {0x02, 0xC0}, {0x03, 0x04}, {0x04, 0x90},
    {0x05, 0x30}, {0x06, 0x90}, {0x07, 0x20}, {0x08, 0x70},
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    {0xFE, 0x02}, {0x0F, 0x05},
    // INTPEE (page 2)
    {0x90, 0x6C}, {0x91, 0x03}, {0x92, 0xC8}, {0x94, 0x66},
    {0x95, 0xB5}, {0x97, 0x64}, {0xA2, 0x11}, {0xFE, 0x00},
    // DNDD (page 2)
    {0xFE, 0x02},
    {0x80, 0xC1}, {0x81, 0x08}, {0x82, 0x08}, {0x83, 0x08},
    {0x84, 0x0A}, {0x86, 0xF0}, {0x87, 0x50}, {0x88, 0x15},
    {0x89, 0x50}, {0x8A, 0x30}, {0x8B, 0x10},
    // ASDE
    {0xFE, 0x01}, {0x21, 0x14},
    {0xFE, 0x02},
    {0xA3, 0x40}, {0xA4, 0x20}, {0xA5, 0x40}, {0xA6, 0x80},
    {0xAB, 0x40}, {0xAE, 0x0C}, {0xB3, 0x34}, {0xB4, 0x44},
    {0xB6, 0x38}, {0xB7, 0x02}, {0xB9, 0x30}, {0x3C, 0x08},
    {0x3D, 0x30}, {0x4B, 0x0D}, {0x4C, 0x20}, {0xFE, 0x00},
    // gamma1 (page 2)
    {0xFE, 0x02},
    {0x10, 0x10}, {0x11, 0x15}, {0x12, 0x1A}, {0x13, 0x1F},
    {0x14, 0x2C}, {0x15, 0x39}, {0x16, 0x45}, {0x17, 0x54},
    {0x18, 0x69}, {0x19, 0x7D}, {0x1A, 0x8F}, {0x1B, 0x9D},
    {0x1C, 0xA9}, {0x1D, 0xBD}, {0x1E, 0xCD}, {0x1F, 0xD9},
    {0x20, 0xE3}, {0x21, 0xEA}, {0x22, 0xEF}, {0x23, 0xF5},
    {0x24, 0xF9}, {0x25, 0xFF},
    // auto gamma
    {0x26, 0x0F}, {0x27, 0x14}, {0x28, 0x19}, {0x29, 0x1E},
    {0x2A, 0x27}, {0x2B, 0x33}, {0x2C, 0x3B}, {0x2D, 0x45},
    {0x2E, 0x59}, {0x2F, 0x69}, {0x30, 0x7C}, {0x31, 0x89},
    {0x32, 0x98}, {0x33, 0xAE}, {0x34, 0xC0}, {0x35, 0xCF},
    {0x36, 0xDA}, {0x37, 0xE2}, {0x38, 0xE9}, {0x39, 0xF3},
    {0x3A, 0xF9}, {0x3B, 0xFF},
    // YCP
    {0xD1, 0x30}, {0xD2, 0x30}, {0xD3, 0x45}, {0xDD, 0x14},
    {0xDE, 0x86}, {0xED, 0x01}, {0xD8, 0xD8},
    // LSC (page 1)
    {0xFE, 0x01},
    {0xA1, 0x80}, {0xA2, 0x80}, {0xA4, 0x00}, {0xA5, 0x00},
    {0xA6, 0x70}, {0xA7, 0x00}, {0xA8, 0x77}, {0xA9, 0x77},
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    {0xFE, 0x00},
    // CC
    {0xFE, 0x02},
    {0xC0, 0x01}, {0xC1, 0x50}, {0xC2, 0xF9}, {0xC3, 0x00},
    {0xC4, 0xE8}, {0xC5, 0x48}, {0xC6, 0xF0}, {0xC7, 0x50},
    {0xC8, 0xF2}, {0xC9, 0x00}, {0xCA, 0xE0}, {0xCB, 0x45},
    {0xCC, 0xEC}, {0xCD, 0x45}, {0xCE, 0xF0}, {0xCF, 0x00},
    {0xE3, 0xF0}, {0xE4, 0x45}, {0xE5, 0xE8}, {0xFE, 0x00},
    {0xF2, 0x0F},
    // frame rate (50 Hz base)
    {0xF7, 0x1D}, {0xF8, 0x84}, {0xFA, 0x00},
    {0x05, 0x01}, {0x06, 0x3B}, {0x07, 0x01}, {0x08, 0x0B},
    {0xFE, 0x01},
    {0x25, 0x01}, {0x26, 0x32}, {0x27, 0x03}, {0x28, 0x96},
    {0x29, 0x03}, {0x2A, 0x96}, {0x2B, 0x03}, {0x2C, 0x96},
    {0x2D, 0x04}, {0x2E, 0x62}, {0x3C, 0x00}, {0xFE, 0x00},
    // dark sun
    {0x18, 0x22}, {0xFE, 0x02}, {0x40, 0xBF}, {0x46, 0xCF}, {0xFE, 0x00},
    // final timing + crop 320x240
    {0xF7, 0x1D}, {0xF8, 0x84}, {0xFA, 0x10},
    {0x05, 0x01}, {0x06, 0x18}, {0x07, 0x00}, {0x08, 0x2E},
    {0xFE, 0x01},
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    {0x97, 0x01}, {0x98, 0x40},  // out_width  = 320
    // end sentinel
    {kRegEnd, kRegEnd},
};

// RGB565 output override
static const uint8_t kGc2145Rgb565Override[][2] = {
    {0xFE, 0x00},
    {0x84, 0x06},   // output format = RGB565
    {0x86, 0x02},   // VSYNC active high
    {kRegEnd, kRegEnd},
};

// ── Driver implementation ──────────────────────────────────────────────────

void Gc2145Camera::init(nema::Runtime& rt, Xl9535& expander) {
    rt_       = &rt;
    expander_ = &expander;
}

bool Gc2145Camera::sccbInit() {
    auto applyTable = [](const uint8_t table[][2]) -> bool {
        bool ok = true;
        for (size_t i = 0; ; i++) {
            uint8_t reg = table[i][0];
            uint8_t val = table[i][1];
            if (reg == kRegEnd && val == kRegEnd) break;
            if (reg == kRegDly) { vTaskDelay(pdMS_TO_TICKS(val)); continue; }
            Wire.beginTransmission(I2C_ADDR_GC2145);
            Wire.write(reg);
            Wire.write(val);
            if (Wire.endTransmission() != 0) ok = false;
        }
        return ok;
    };
    bool ok = applyTable(kGc2145DefaultInit);
    ok &= applyTable(kGc2145Rgb565Override);
    return ok;
}

// ── ISR callbacks (must be in IRAM — called from DVP interrupt context) ──────
// DVP controller uses on_get_new_trans to get the buffer for each frame,
// and on_trans_finished to signal completion. Both run from ISR.

static bool IRAM_ATTR s_onGetNewTrans(esp_cam_ctlr_handle_t /*h*/,
                                       esp_cam_ctlr_trans_t* t, void* ud) {
    auto* cam  = static_cast<Gc2145Camera*>(ud);
    t->buffer  = cam->frameBuf_;
    t->buflen  = Gc2145Camera::kFrameBytes;
    return false;
}

static bool IRAM_ATTR s_onTransFinished(esp_cam_ctlr_handle_t /*h*/,
                                          esp_cam_ctlr_trans_t* /*t*/, void* ud) {
    auto*       cam   = static_cast<Gc2145Camera*>(ud);
    BaseType_t  woken = pdFALSE;
    xSemaphoreGiveFromISR((SemaphoreHandle_t)cam->frameSem_, &woken);
    return woken == pdTRUE;
}

// ── ICamera + IService implementation ────────────────────────────────────────

void Gc2145Camera::start() {
    frameSem_ = xSemaphoreCreateBinary();

    frameBuf_ = (uint8_t*)heap_caps_malloc(kFrameBytes,
                    MALLOC_CAP_SPIRAM | MALLOC_CAP_DMA);
    if (!frameBuf_) {
        if (rt_) rt_->log().error("Gc2145Camera", "PSRAM frame buffer alloc failed");
        return;
    }

    esp_cam_ctlr_dvp_pin_config_t pins = {};
    pins.data_width = CAM_CTLR_DATA_WIDTH_8;
    pins.data_io[0] = (gpio_num_t)PIN_CAM_D0;
    pins.data_io[1] = (gpio_num_t)PIN_CAM_D1;
    pins.data_io[2] = (gpio_num_t)PIN_CAM_D2;
    pins.data_io[3] = (gpio_num_t)PIN_CAM_D3;
    pins.data_io[4] = (gpio_num_t)PIN_CAM_D4;
    pins.data_io[5] = (gpio_num_t)PIN_CAM_D5;
    pins.data_io[6] = (gpio_num_t)PIN_CAM_D6;
    pins.data_io[7] = (gpio_num_t)PIN_CAM_D7;
    pins.vsync_io   = (gpio_num_t)PIN_CAM_VSYNC;
    pins.de_io      = (gpio_num_t)PIN_CAM_HREF;
    pins.pclk_io    = (gpio_num_t)PIN_CAM_PCLK;
    pins.xclk_io    = (gpio_num_t)PIN_CAM_XCLK;

    esp_cam_ctlr_dvp_config_t cfg = {};
    cfg.ctlr_id               = 0;
    cfg.clk_src               = CAM_CLK_SRC_DEFAULT;
    cfg.h_res                 = kFrameW;
    cfg.v_res                 = kFrameH;
    cfg.input_data_color_type = CAM_CTLR_COLOR_RGB565;
    cfg.cam_data_width        = 8;
    cfg.xclk_freq             = 20 * 1000 * 1000;
    cfg.pin                   = &pins;

    esp_cam_ctlr_handle_t handle = nullptr;
    if (esp_cam_new_dvp_ctlr(&cfg, &handle) != ESP_OK) {
        if (rt_) rt_->log().error("Gc2145Camera", "esp_cam_new_dvp_ctlr failed");
        heap_caps_free(frameBuf_); frameBuf_ = nullptr;
        return;
    }
    camHandle_ = handle;

    // Register ISR callbacks — DVP uses these instead of esp_cam_ctlr_receive()
    esp_cam_ctlr_evt_cbs_t cbs = {};
    cbs.on_get_new_trans  = s_onGetNewTrans;
    cbs.on_trans_finished = s_onTransFinished;
    esp_cam_ctlr_register_event_callbacks(handle, &cbs, this);

    // Pulse camera reset — XCLK must be running before SCCB will ACK
    expander_->setCamReset(true);
    vTaskDelay(pdMS_TO_TICKS(50));
    expander_->setCamReset(false);
    vTaskDelay(pdMS_TO_TICKS(300));

    if (rt_) rt_->log().info("Gc2145Camera", "started",
        {{"w", std::to_string(kFrameW)}, {"h", std::to_string(kFrameH)}});
}

void Gc2145Camera::stop() {
    close();
    if (camHandle_) {
        esp_cam_ctlr_del((esp_cam_ctlr_handle_t)camHandle_);
        camHandle_ = nullptr;
    }
    if (frameBuf_) {
        heap_caps_free(frameBuf_);
        frameBuf_ = nullptr;
    }
    if (frameSem_) {
        vSemaphoreDelete((SemaphoreHandle_t)frameSem_);
        frameSem_ = nullptr;
    }
    sensorInited_ = false;
}

bool Gc2145Camera::open() {
    if (!camHandle_ || !frameBuf_) return false;
    if (open_) return true;

    if (!sensorInited_) {
        Wire.beginTransmission(I2C_ADDR_GC2145);
        if (Wire.endTransmission() != 0) {
            if (rt_) rt_->log().warn("Gc2145Camera", "GC2145 not found at 0x3C");
            return false;
        }
        if (!sccbInit())
            if (rt_) rt_->log().warn("Gc2145Camera", "SCCB init incomplete");
        sensorInited_ = true;
    }

    esp_cam_ctlr_handle_t h = (esp_cam_ctlr_handle_t)camHandle_;
    esp_cam_ctlr_enable(h);
    esp_cam_ctlr_start(h);
    open_ = true;
    return true;
}

void Gc2145Camera::close() {
    if (!open_ || !camHandle_) return;
    esp_cam_ctlr_handle_t h = (esp_cam_ctlr_handle_t)camHandle_;
    esp_cam_ctlr_stop(h);
    esp_cam_ctlr_disable(h);
    open_ = false;
}

const uint8_t* Gc2145Camera::captureFrame() {
    if (!open_ || !camHandle_ || !frameBuf_ || !frameSem_) return nullptr;
    // Block until ISR signals frame complete (100ms timeout → ~10fps floor)
    if (xSemaphoreTake((SemaphoreHandle_t)frameSem_, pdMS_TO_TICKS(100)) != pdTRUE)
        return nullptr;
    return frameBuf_;
}

} // namespace nema::skyrizze32
